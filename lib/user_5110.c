#include "stm32f1xx_hal.h"
#include "main.h"
#include "gpio.h"
#include "spi.h"
#include "user_5110.h"

void HAL_SPI_TxCpltCallback(SPI_HandleTypeDef *hspi2){//IMPLEMENTS THE CALLBACK FUNCTION FOR DMA SPI COMPLETE
  LCD_Callback();
}

const unsigned char font6x8[][6] =
{
{ 0x00, 0x00, 0x00, 0x00, 0x00, 0x00 },// sp
{ 0x00, 0x00, 0x00, 0x2f, 0x00, 0x00 },// !
{ 0x00, 0x00, 0x07, 0x00, 0x07, 0x00 },// "
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{ 0x14, 0x14, 0x14, 0x14, 0x14, 0x14 }// horiz lines
};
uint8_t testbmap[] ={
0x07, 0xFF, 0xFF, 0xFC, 0xFF, 0xFF, 0xF3, 0xFF, 0xFF, 0xFF, 0xFF, 0xE7,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 0xFF, 
0xE0, 0xF1, 0x9D, 0x7F, 0x7F, 0xFF, 0xFF, 0xFF, 0xFF, 0xFF, 0xFF, 0x3F,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 0x3F, 
0xC1, 0xFD, 0xF8, 0xF9, 0xFE, 0xFC, 0x9D, 0x8F, 0x07, 0x1B, 0x9E, 0xC3,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 0x10, 
0x60, 0x71, 0x30, 0x9C, 0xCE, 0xF7, 0xFB, 0xFC, 0xFE, 0xEF, 0xFF, 0xFF,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 0x00, 
0xFC, 0xFE, 0xFF, 0xFF, 0xFF, 0xFF, 0xFF, 0xFF, 0xFF, 0xFF, 0xFF, 0xFF,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 0x00, 
0x59, 0x33, 0x6F, 0x9F, 0x7F, 0xFF, 0xFF, 0xFF, 0xFF, 0xFF, 0xFF, 0xFF,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 0x07
};
uint8_t testbmap1[] ={
0x03, 0x03, 0x03, 0x01, 0x01, 0x00, 0x00, 0x00, 0x00, 0x00, 0x00, 0x00,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 0x00, 
0x00, 0xC0, 0xE0, 0xC0, 0x00, 0x00, 0x00, 0x00, 0x00, 0x00, 0x00, 0x00,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 0xFF, 
0xFE, 0xFF, 0xFF, 0xFF, 0xFF, 0x58, 0xE0, 0xF0, 0xF8, 0xF8, 0xFC, 0xDA,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 0xFF, 
0xFF, 0xFF, 0xFF, 0x7F, 0x17, 0x03, 0x05, 0x07, 0x0F, 0x0F, 0x1F, 0x1F,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 0xFF, 
0x03, 0x01, 0x00, 0x00, 0x00, 0x00, 0x00, 0x00, 0x00, 0x00, 0x00, 0x00,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 0xFF, 
0x00, 0x00, 0x00, 0x00, 0x00, 0x00, 0x00, 0x00, 0x00, 0x00, 0x00, 0x00,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 0x0F
};
uint8_t spiOK = 0;

/**
 * Initialize LCD.
 */
void LCD_Init(void) {
  LCD_Reset();
  LCD_Write_Command(0x21);//use extended instruction set
  LCD_Write_Command(0xCC);//select contrast
  LCD_Write_Command(0x20);
  LCD_Write_Command(0x0C);
  LCD_Clear();
}

/**
 * Reset LCD.
 */
void LCD_Reset(void) {
  HAL_GPIO_WritePin(LCD_RESET_PORT, LCD_RESET_PIN, GPIO_PIN_RESET);
  HAL_Delay(50);
  HAL_GPIO_WritePin(LCD_RESET_PORT, LCD_RESET_PIN, GPIO_PIN_SET);
}

/**
 * Set LCD cursor position.
 * @param PosX X Position
 * @param PosY Y Position
 */
void LCD_Set_Postion(uint8_t PosX, uint8_t PosY) {
  LCD_Write_Command(0x40 | PosY);
  LCD_Write_Command(0x80 | PosX);
}

/**
 * Clear all contents on LCD.
 */
void LCD_Clear(void) {
  uint8_t t;
  uint8_t k;
  LCD_Set_Postion(0,0);
  for(t=0;t<6;t++)
  {
    for(k=0;k<84;k++)
    {
      LCD_Write_Data(0x00);
    }
  }
}

/**
 * Write a single char to LCD.
 * @param ch char to write.
 */
void LCD_Write_Char(uint8_t ch) {
  uint8_t line;
  ch -= 32;
  for (line=0; line<6; line++) LCD_Write_Data(font6x8[ch][line]);
}

/**
 * Write a string to LCD.
 * @param PosX X start point
 * @param PosY Y start point
 * @param str  string to write.
 */
void LCD_Write_String(uint8_t PosX, uint8_t PosY, char *str) {
  LCD_Set_Postion(PosX, PosY);
  while(* str) {
    LCD_Write_Char(* str);
    str ++;
  }
}

/**
 * Write LCD command to SPI
 * @param cmd command to write.
 */
void LCD_Write_Command(uint8_t cmd) {
  uint32_t tickStart = HAL_GetTick();
  while(!spiOK) {
    if ((HAL_GetTick() - tickStart) > LCD_MAX_TIMEOUT_TICKS) {
      break; // Oops!
    }//magari così è un po piu veloce, ma non è certamente asincrono
  }
  HAL_GPIO_WritePin(LCD_CE_PORT, LCD_CE_PIN, GPIO_PIN_RESET);
  HAL_GPIO_WritePin(LCD_DC_PORT, LCD_DC_PIN, GPIO_PIN_RESET);
  //this should work
  spiOK = 0;
  HAL_SPI_Transmit_DMA(&LCD_SPI_INTERFACE, &cmd, 0x01);
  //if it doesn't uncomment the following and comment the previous
  /*HAL_SPI_Transmit(&LCD_SPI_INTERFACE, &cmd, 0x01,LCD_MAX_TIMEOUT_TICKS);
  HAL_GPIO_WritePin(LCD_CE_PORT, LCD_CE_PIN, GPIO_PIN_SET);
  HAL_GPIO_WritePin(LCD_DC_PORT, LCD_DC_PIN, GPIO_PIN_SET);
  */
  
}

/**
 * Write LCD data to SPI
 * @param data data to write.
 */
void LCD_Write_Data(uint8_t data) {
  uint32_t tickStart = HAL_GetTick();
  while(!spiOK) {
    if ((HAL_GetTick() - tickStart) > LCD_MAX_TIMEOUT_TICKS) {
      break; // Oops!
    }
  }
  HAL_GPIO_WritePin(LCD_CE_PORT, LCD_CE_PIN, GPIO_PIN_RESET);
  HAL_GPIO_WritePin(LCD_DC_PORT, LCD_DC_PIN, GPIO_PIN_SET);
  //this should work
  spiOK = 0;
  HAL_SPI_Transmit_DMA(&LCD_SPI_INTERFACE, &data, 0x01);
  //if it doesn't uncomment the following and comment the previous  
  /*HAL_SPI_Transmit(&LCD_SPI_INTERFACE, &data, 0x01,LCD_MAX_TIMEOUT_TICKS);
  HAL_GPIO_WritePin(LCD_CE_PORT, LCD_CE_PIN, GPIO_PIN_SET);
  HAL_GPIO_WritePin(LCD_DC_PORT, LCD_DC_PIN, GPIO_PIN_RESET);*/
  
}

/**
 * Change LCD contrast
 * @param contrast 0-127 unsigned int.
 */
void LCD_Set_Contrast(uint8_t contrast) {
  LCD_Write_Command(0x21);//use extended instruction set
  LCD_Write_Command(contrast|0b10000000);//select contrast
  LCD_Write_Command(0x20);
}

/**
 * Write a preformatted bitmap of 504 byte
 * @param bmp bitmap, horizzontal addressing print
 */
void LCD_Write_Bitmap(uint8_t * bmp){
  LCD_Clear();
  LCD_Set_Postion(0,0);
  for(int i=0;i<504;i++){
    LCD_Write_Data(bmp[i]);
  }
}
/**
 * Print Lenna test image
 */
void LCD_Test_Image(void){
  LCD_Write_Bitmap(testbmap);
}

/**
 * Print Roberto Sorrentino's face
 */
void LCD_Sorrentino(void){
  LCD_Write_Bitmap(testbmap1);
}

void LCD_Inverse_Mode(void){
  LCD_Write_Command(0x20);
  LCD_Write_Command(0x0D);
}

void LCD_Direct_Mode(void){
  LCD_Write_Command(0x20);
  LCD_Write_Command(0x0C);    
}

/**
 * HAL SPI transfer complete callback
 * @param hspi HAL SPI handler.
 */
void LCD_Callback(void) {
  spiOK = 1;
  HAL_GPIO_WritePin(LCD_CE_PORT, LCD_CE_PIN, GPIO_PIN_SET);
  HAL_GPIO_TogglePin(LCD_DC_PORT, LCD_DC_PIN);
}

/**
 * Power off the LCD
 */
void LCD_Power_Off(void){
  LCD_Clear();
  LCD_Write_Command(0b00100100);
}